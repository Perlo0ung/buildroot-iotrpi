## external_packages/packages/Config.in
```kconfig
menu "IOTRPI packages"
	source "$BR2_EXTERNAL/gpiomod/Config.in"
	source "$BR2_EXTERNAL/ledtest/Config.in"
endmenu
```

## packages/gpiomod/Config.in
```kconfig
config BR2_PACKAGE_GPIOMOD
    bool "gpiomod"
    help
            kernel GPIO module
```

## packages/ledtest/Config.in
```kconfig
config BR2_PACKAGE_LEDTEST
    bool "ledtest"
    default y
    help
            Simple ledtest application.
```
